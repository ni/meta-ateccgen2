/dts-v1/;

#include "imx8qp-apalis-v1.1.dtsi"
#include "imx8-apalis-smartracks.dtsi"

/ {
	model = "Apalis iMX8QP 2GB V1.1C";
	compatible = "toradex,apalis-imx8qp-v1.1-eval",
		     "toradex,apalis-imx8qp-v1.1",
		     "toradex,apalis-imx8-v1.1",
		     "toradex,apalis-imx8",
		     "fsl,imx8qp",
		     "fsl,imx8qm";
};
