/dts-v1/;

#include "imx8qxp-apalis.dtsi"
#include "imx8qxp-apalis-smartracks.dtsi"

/ {
	model = "Toradex Apalis iMX8QXP on SmartRacks Custom Board";
	compatible = "toradex,apalis-imx8x-eval",
		     "toradex,apalis-imx8x",
		     "fsl,imx8qxp";
};
