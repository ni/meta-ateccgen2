## conf/layer.conf
```bitbake
# We have a conf and classes directory, add to BBPATH
BBPATH .= ":${LAYERDIR}"

# We have recipes-* directories, add to BBFILES
BBFILES += "${LAYERDIR}/recipes-*/*/*.bb \
            ${LAYERDIR}/recipes-*/*/*.bbappend"

BBFILE_COLLECTIONS += "meta-ateccgen2"
BBFILE_PATTERN_meta-ateccgen2 = "^${LAYERDIR}/"

# priority level 25 allows meta-ateccgen2 layer to override certain recipes in meta-toradex-demos (priority level 24)
BBFILE_PRIORITY_meta-ateccgen2 = "25"

LAYERDEPENDS_meta-ateccgen2 = "core"
LAYERSERIES_COMPAT_meta-ateccgen2 = "dunfell"
```

## conf/machine/apalis-imx8.conf
```bitbake
#@TYPE: Machine
#@NAME: Toradex Apalis iMX8
#@DESCRIPTION: Toradex Apalis iMX8 powered by a i.MX 8QuadMax SoC
#@MAINTAINER: Stefan Agner <stefan.agner@toradex.com>

MACHINE_NAME = "Apalis-iMX8"

SOC_SILICON_REV ?= ""

MACHINEOVERRIDES =. "mx8:mx8qm:"

IMX_DEFAULT_BSP = "nxp"

require conf/machine/include/imx-base.inc
# override imx-base.inc which sets this to cortexa72-cortexa53-crypto
DEFAULTTUNE_mx8qm = "aarch64"
require conf/machine/include/tune-cortexa72-cortexa53.inc

# Don't include kernels in standard images
RDEPENDS_${KERNEL_PACKAGE_NAME}-base = ""

LOADADDR = ""

# we do not want to have getty running on tty1 as we run
# auto-serial-console there
USE_VT = "0"

KERNEL_DEVICETREE = " \
    freescale/imx8qp-apalis-v1.1-eval.dtb \
"

KERNEL_IMAGETYPE_aarch64 = "Image.gz"

UBOOT_SUFFIX = "bin"
UBOOT_CONFIG ??= "sd"
UBOOT_CONFIG[sd] = "apalis-imx8_defconfig,sdcard"

UBOOT_ENTRYPOINT = "0x96000000"
UBOOT_DTB_LOADADDRESS = "0x83000000"
UBOOT_DTBO_LOADADDRESS = "0x83100000"
UBOOT_RD_LOADADDRESS = "0xA0000000"

BOOT_SPACE = "65536"
IMX_BOOT_SEEK = "32"

IMAGE_BOOT_FILES_append = " boot.scr-${MACHINE};boot.scr hdmitxfw.bin dpfw.bin"
WKS_FILE_DEPENDS_append = " u-boot-default-script"
PREFERRED_PROVIDER_u-boot-default-script = "u-boot-distro-boot"

PREFERRED_PROVIDER_virtual/kernel = "linux-toradex"
PREFERRED_PROVIDER_virtual/kernel_preempt-rt = "linux-toradex"
PREFERRED_PROVIDER_virtual/bootloader = "u-boot-toradex"
PREFERRED_PROVIDER_u-boot = "u-boot-toradex"
# Currently we use the nxp 2020.04 downstream for mx8 as some features are
# not yet available in 2020.07.
PREFERRED_VERSION_u-boot-toradex = "2020.04%"

MACHINE_FIRMWARE_append = " linux-firmware-pcie8997"
MACHINE_FIRMWARE_append = " firmware-imx-vpu-imx8"
MACHINE_FIRMWARE_append = " firmware-imx-8"

IMXBOOT_TARGETS = "flash_b0"

PREFERRED_PROVIDER_imx-sc-firmware = "imx-sc-firmware-toradex"
BOARD_TYPE = "apalis"

IMAGE_CLASSES_append = " image_type_tezi"
IMAGE_FSTYPES += "teziimg"

# The imx-boot container takes care for the i.MX 8 offset, so the container
# has to be flashed at offset 0 directly
UBOOT_BINARY_TEZI_EMMC = "imx-boot"
OFFSET_BOOTROM_PAYLOAD = "0"

TEZI_EXTERNAL_KERNEL_DEVICETREE_BOOT = "apalis-imx8_hdmi_overlay.dtbo"

TORADEX_PRODUCT_IDS = "0037 0047 0048 0049"
TORADEX_PRODUCT_IDS[0037] = "imx8qm-apalis-v1.1-eval.dtb"
TORADEX_PRODUCT_IDS[0047] = "imx8qm-apalis-v1.1-eval.dtb"
TORADEX_PRODUCT_IDS[0048] = "imx8qp-apalis-v1.1-eval.dtb"
TORADEX_PRODUCT_IDS[0049] = "imx8qp-apalis-v1.1-eval.dtb"
```

## conf/machine/apalis-imx8x-smartracks.conf
```bitbake
#@TYPE: Machine
#@NAME: Toradex Apalis iMX8X
#@DESCRIPTION: Toradex Apalis iMX8X powered by a i.MX 8X SoC
#@MAINTAINER: Philippe Schenker <philippe.schenker@toradex.com>

MACHINE_NAME = "Apalis-iMX8X-SmartRacks"

# for C0 silicon add mx8qxpc0 to the right of mx8qxp
SILICON-OVERRIDES ?= "mx8qxpc0:"
MACHINEOVERRIDES =. "mx8:mx8x:mx8qxp:${SILICON-OVERRIDES}"

IMX_DEFAULT_BSP = "nxp"

require conf/machine/include/imx-base.inc
# if one wants cortexa35-crypto, set DEFAULTTUNE accordingly
DEFAULTTUNE_mx8qxp = "aarch64"
require conf/machine/include/tune-cortexa35.inc

# Don't include kernels in standard images
RDEPENDS_${KERNEL_PACKAGE_NAME}-base = ""

LOADADDR = ""

# we do not want to have getty running on tty1 as we run
# auto-serial-console there
USE_VT = "0"

KERNEL_DEVICETREE = " \
    freescale/imx8qxp-apalis-smartracks.dtb \
"

KERNEL_IMAGETYPE_aarch64 = "Image.gz"

UBOOT_SUFFIX = "bin"
UBOOT_CONFIG ??= "sd"
UBOOT_CONFIG[sd] = "apalis-imx8x_defconfig,sdcard"

UBOOT_ENTRYPOINT = "0x80280000"
UBOOT_RD_LOADADDRESS = "0xA0000000"

BOOT_SPACE = "65536"
IMX_BOOT_SEEK = "32"

IMAGE_BOOT_FILES_append = " boot.scr-${MACHINE};boot.scr"
WKS_FILE_DEPENDS_append = " u-boot-default-script"
PREFERRED_PROVIDER_u-boot-default-script = "u-boot-distro-boot"

PREFERRED_PROVIDER_virtual/kernel = "linux-toradex"
PREFERRED_PROVIDER_virtual/kernel_preempt-rt = "linux-toradex"
PREFERRED_PROVIDER_virtual/bootloader = "u-boot-toradex"
# Currently we use the nxp 2020.04 downstream for mx8 as some features are
# not yet available in 2020.07.
PREFERRED_VERSION_u-boot-toradex = "2020.04%"

MACHINE_FIRMWARE_append = " linux-firmware-usb8997"
MACHINE_FIRMWARE_append = " firmware-imx-vpu-imx8"

IMXBOOT_TARGETS = "flash"

PREFERRED_PROVIDER_imx-sc-firmware = "imx-sc-firmware-toradex"
BOARD_TYPE = "apalis"

IMAGE_CLASSES_append = " image_type_tezi"
IMAGE_FSTYPES += "teziimg"

# The imx-boot container takes care for the i.MX 8 offset, so the container
# has to be flashed at offset 0 directly
UBOOT_BINARY_TEZI_EMMC = "imx-boot"
OFFSET_BOOTROM_PAYLOAD = "0"

TEZI_EXTERNAL_KERNEL_DEVICETREE_BOOT = "smartracks_overlay.dtbo"

TORADEX_PRODUCT_IDS = "0046 0053 0054 2600"
```

## conf/machine/include/apalis-imx8.inc
```bitbake
DISTRO_FEATURES:remove = " 3g alsa bluetooth wifi nfc "
MACHINE_FEATURES:remove = " alsa bluetooth wifi "
```
